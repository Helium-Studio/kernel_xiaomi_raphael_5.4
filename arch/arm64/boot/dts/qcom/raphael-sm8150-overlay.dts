/* Copyright (c) 2017-2018, The Linux Foundation. All rights reserved.
 *
 * This program is free software; you can redistribute it and/or modify
 * it under the terms of the GNU General Public License version 2 and
 * only version 2 as published by the Free Software Foundation.
 *
 * This program is distributed in the hope that it will be useful,
 * but WITHOUT ANY WARRANTY; without even the implied warranty of
 * MERCHANTABILITY or FITNESS FOR A PARTICULAR PURPOSE.  See the
 * GNU General Public License for more details.
 */

/dts-v1/;
/plugin/;

#include <dt-bindings/clock/qcom,gcc-sm8150.h>
#include <dt-bindings/clock/qcom,camcc-sm8150.h>
#include <dt-bindings/clock/qcom,rpmh.h>
#include <dt-bindings/interrupt-controller/arm-gic.h>

#include "raphael-sm8150.dtsi"
#include "raphael-audio-overlay.dtsi"

/ {
	model = "RAPHAEL";
	compatible = "qcom,sm8150-cdp", "qcom,sm8150", "qcom,cdp";
	qcom,board-id = <40 0>;
};

&snd_934x {
	io-channels =
		<&pm8150b_charger PSY_IIO_TYPEC_POWER_ROLE>,
		<&pm8150b_charger PSY_IIO_TYPEC_MODE>;
	io-channel-names =
		"typec_power_role",
		"typec_mode";
};
